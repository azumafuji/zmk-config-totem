## config/west.yml
```yaml
manifest:
  remotes:
    - name: zmkfirmware
      url-base: https://github.com/zmkfirmware
    - name: azumafuji
      url-base: https://github.com/azumafuji
  projects:
    - name: zmk
      remote: zmkfirmware
      revision: v0.3
      import: app/west.yml
    - name: zmk-dongle-screen
      remote: azumafuji
      revision: feature-lock-status-indicator
  self:
    path: config
```
